/*
 * Этот код предназначен для управления светодиодной матрицей 8x8, подключенной через SPI, * с использованием библиотеки AlashLEDMatrix8x8. 
 * Он инициализирует матрицу, устанавливает яркость и прокручивает текст по дисплею. 
 * Пользователь может выбрать направление прокрутки, закомментировав одну из строк. 
 * Функции drawString и drawSprite используются для отображения текста и спрайтов.
*/

#include <AlashLEDMatrix8x8.hpp>

// Определяем пин ChipSelect для светодиодной матрицы (не используйте пины SS или MISO на Arduino!)
const uint8_t CHIP_SELECT_PIN = 9;

// Количество подключаемых сегментов 8x8
const int MATRIX_SEGMENTS = 1;
const int MATRIX_WIDTH = MATRIX_SEGMENTS * 8;

// Экземпляр класса AlashLEDMatrix8x8
AlashLEDMatrix8x8 ledMatrix(MATRIX_SEGMENTS, CHIP_SELECT_PIN);

// Текст для вывода
char text[] = "** LED MATRIX DEMO! ** (1234567890) ++ \"ABCDEFGHIJKLMNOPQRSTUVWXYZ\" ++ <$%/=?'.@,> --";

// Скорость прокрутки текста (чем меньше значение, тем быстрее прокрутка)
const int ANIM_DELAY = 30;

// Закомментируйте одну из строк ниже для выбора направления прокрутки
#define L2R  // Прокрутка слева направо
// #define R2L  // Прокрутка справа налево

void setup() {
    // Инициализация дисплея
    ledMatrix.setEnabled(true);
    ledMatrix.setIntensity(2); // 0 = низкая яркость, 10 = высокая яркость
}

int currentX = 0, currentY = 0; // начальная позиция верхний левый угол

// Определение шрифта. Вы можете использовать http://gurgleapps.com/tools/matrix для создания собственного шрифта или спрайтов.
byte font[95][8] = { {0,0,0,0,0,0,0,0}, // SPACE
                     {0x10,0x18,0x18,0x18,0x18,0x00,0x18,0x18}, // EXCL
                     {0x28,0x28,0x08,0x00,0x00,0x00,0x00,0x00}, // QUOT
                     {0x00,0x0a,0x7f,0x14,0x28,0xfe,0x50,0x00}, // #
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                     {0x00,0x7c,0x04,0x08,0x7c,0x20,0x40,0xfe}, // Z
                      // (the font does not contain any lower case letters. you can add your own.)
                  };    // {}, //



void loop() {
    // Отрисовка текста на текущей позиции
    int len = strlen(text);
    drawString(text, len, currentX, 0);

    // Отображение нового буфера кадра
    ledMatrix.display();

    // Задержка для читабельности дисплея
    delay(ANIM_DELAY);

    #ifdef L2R
    // Прокрутка слева направо
    if (++currentX > MATRIX_WIDTH) {
        currentX = -len * 8;
    }
    #endif

    #ifdef R2L
    // Прокрутка справа налево
    if (--currentX < len * -8) {
        currentX = MATRIX_WIDTH;
    }
    #endif
}

// Функция отрисовки строки заданной длины на указанной позиции
void drawString(char* text, int len, int x, int y) {
    for (int idx = 0; idx < len; idx++) {
        int c = text[idx] - 32;

        // Прекратить, если символ находится за видимой областью
        if (x + idx * 8 > MATRIX_WIDTH) return;

        // Отрисовка только видимых символов
        if (8 + x + idx * 8 > 0) {
            drawSprite(font[c], x + idx * 8, y, 8, 8);
        }
    }
}

// Функция отрисовки спрайта на указанной позиции с заданной шириной и высотой (обычно 8x8)
void drawSprite(byte* sprite, int x, int y, int width, int height) {
    // Маска используется для получения бита столбца из строки спрайта
    byte mask = B10000000;

    for (int iy = 0; iy < height; iy++) {
        for (int ix = 0; ix < width; ix++) {
            ledMatrix.setPixel(x + ix, y + iy, (bool)(sprite[iy] & mask));

            // Смещение маски на один пиксель вправо
            mask = mask >> 1;
        }

        // Сброс маски столбца
        mask = B10000000;
    }
}
