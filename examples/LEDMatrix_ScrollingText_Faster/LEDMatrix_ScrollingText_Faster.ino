/*
 * Этот код предназначен для управления светодиодной матрицей 8x8, подключенной через SPI, с использованием библиотеки AlashLEDMatrix8x8. 
 * Он инициализирует матрицу, устанавливает яркость и прокручивает текст по дисплею. 
 * Функции nextChar, nextCol, и writeCol используются для управления прокруткой текста и отрисовки символов. 
 * В loop вызывается функция marquee, которая отвечает за обновление дисплея.
*/
#include <AlashLEDMatrix8x8.hpp>

// Установите пин Chip Select (CS) для светодиодной матрицы
const uint8_t CS_PIN = 9;
// Количество подключаемых модулей
const uint8_t NUM_SEGMENTS = 8;
// Ширина всего дисплея
const uint16_t DISPLAY_WIDTH = NUM_SEGMENTS * 8;

// Инициализация AlashLEDMatrix8x8
AlashLEDMatrix8x8 ledMatrix(NUM_SEGMENTS, CS_PIN, AlashLEDMatrix8x8::INVERT_SEGMENT_X | AlashLEDMatrix8x8::INVERT_Y);

// Задержка прокрутки в миллисекундах
const uint16_t SCROLL_DELAY = 30;
uint64_t marqueeDelayTimestamp = 0;

// Шрифт, хранящийся в программе
static const uint8_t font[515] PROGMEM = {
  2,0b00000000,0b00000000,                                  /* 032 =   */
  2,0b01101111,0b01101111,                                  /* 033 = ! */
  3,0b00000011,0b00000000,0b00000011,                       /* 034 = " */
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  5,0b00011000,0b00000100,0b00001000,0b00010000,0b00001100  /* 126 = ~ */
};

static const uint16_t font_index[95] PROGMEM = {
  0,3,6,10,16,22,28,34,36,40,44,48,54,57,63,66,72,78,82,88,94,
  100,106,112,118,124,130,133,136,141,147,152,158,164,170,176,
  182,188,194,200,206,212,218,224,230,236,242,248,254,260,266,
  272,278,284,290,296,302,308,314,320,324,330,334,340,346,348,
  354,360,366,372,378,384,390,396,400,405,411,415,421,427,433,
  439,445,451,457,463,469,475,481,487,493,499,503,505,509
};

// Текст для прокрутки
char text[] = " !\"#$%&'()*+,-./0123456789:;<=>?@ABCDEFGHIJKLMNOPQRSTUVWXYZ[\\]^_'abcdefghijklmnopqrstuvwxyz{|}~";
uint16_t textIndex = 0;
uint8_t colIndex = 0;
uint16_t scrollWhitespace = 0;

void nextChar() {
  if (text[++textIndex] == '\0') {
    textIndex = 0;
    scrollWhitespace = DISPLAY_WIDTH;
  }
}

void nextCol(uint8_t width) {
  if (++colIndex == width) {
    scrollWhitespace = 2;
    colIndex = 0;
    nextChar();
  }  
}

void writeCol() {
  if (scrollWhitespace > 0) {
    scrollWhitespace--;
    return;
  }
  
  uint8_t ascii = text[textIndex] - 32;
  uint16_t idx = pgm_read_word(&(font_index[ascii]));
  uint8_t width = pgm_read_byte(&(font[idx]));
  uint8_t column = pgm_read_byte(&(font[colIndex + idx + 1]));
  
  ledMatrix.setColumn(DISPLAY_WIDTH - 1, column);
  nextCol(width);
}

void marquee() {
  if (millis() < 1) marqueeDelayTimestamp = 0;
  if (millis() < marqueeDelayTimestamp) return;
    
  marqueeDelayTimestamp = millis() + SCROLL_DELAY;
  ledMatrix.scroll(AlashLEDMatrix8x8::scrollDirection::scrollLeft);
  writeCol();
  ledMatrix.display();
}

void setup() {
  ledMatrix.setEnabled(true);
  ledMatrix.setIntensity(0);
}

void loop() {
  marquee();
}
